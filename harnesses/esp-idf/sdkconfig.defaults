## harnesses/esp-idf/sdkconfig.defaults
```kconfig
CONFIG_ETH_USE_OPENETH=y
CONFIG_ESP_HTTP_CLIENT_ENABLE_HTTPS=y
CONFIG_MBEDTLS_CERTIFICATE_BUNDLE=y
CONFIG_HONCH_ENABLE_GZIP=n
CONFIG_ESP_TASK_WDT_EN=n
# Honch coredump E2E: write an ELF coredump to a flash partition so the SDK can
# stream the raw image to Capture, then erase-after-ack.
CONFIG_ESPTOOLPY_FLASHSIZE_4MB=y
CONFIG_PARTITION_TABLE_CUSTOM=y
CONFIG_PARTITION_TABLE_CUSTOM_FILENAME="partitions.csv"
CONFIG_ESP_COREDUMP_ENABLE_TO_FLASH=y
# Format (ELF) and checksum are auto-selected by ESP_COREDUMP_ENABLE in IDF v6;
# they are select-only symbols and cannot be set here.
```
